## main/Kconfig.projbuild
```kconfig
menu "ZigBeetle Configuration"

config USE_104NT4
    bool "Use 104NT-4 thermistor instead of AHT21B"
    default y
    help
        When enabled, the firmware uses a 104NT-4 thermistor on ADC GPIO4
        and disables the current AHT21B (ASAIR) LP-core I2C path.

config DEBUG
    bool "Enable diagnostic info logs"
    default n
    help
        Enables optional informational diagnostics such as LP sensor counters
        and raw HP probe bytes. Disable to reduce serial log noise.

endmenu
```

## sdkconfig.defaults
```kconfig
CONFIG_ULP_COPROC_ENABLED=y
CONFIG_ULP_COPROC_TYPE_LP_CORE=y
CONFIG_ZB_ENABLED=y
CONFIG_ZB_ZED=y
CONFIG_ZB_RADIO_NATIVE=y
CONFIG_USE_104NT4=y
CONFIG_DEBUG=n
CONFIG_COMPILER_OPTIMIZATION_SIZE=y
CONFIG_COMPILER_OPTIMIZATION_ASSERTIONS_DISABLE=y
CONFIG_LOG_DEFAULT_LEVEL_WARN=y
CONFIG_NEWLIB_NANO_FORMAT=y
CONFIG_PARTITION_TABLE_CUSTOM=y
CONFIG_PARTITION_TABLE_CUSTOM_FILENAME="partitions.csv"
```
